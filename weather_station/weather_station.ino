#include <Wire.h>
#include <SPI.h>
#include <EEPROM.h>

#include "Adafruit_SGP30.h"
Adafruit_SGP30 sgp;

#include <Adafruit_BME280.h>
Adafruit_BME280 bme;

#include "U8glib.h";
U8GLIB_SSD1306_128X64 u8g(13, 11, 10, 9, 8);

int screen = 1;
#define btnPin1 5                // кнопка 1
#define btnPin2 4                // кнопка 2
#define pinOnBME 6               // включение датчика BME280
#define pinOnCO2 7               // включение датчика SGP30
#define pinRx 2                  // пин приемника
#define pinOnRx 3                // включение приемника
boolean RxFlag = 0;              // флаг для приемника
boolean CO2Flag = 1;             // флаг для датчика SGP30
int voltage = 0;                 // процент заряда АКБ
float zero_pressure = 1050.0;    // давление в нулевой точке

#include "OneButton.h"
OneButton button1(btnPin1, false);
OneButton button2(btnPin2, false);

unsigned long StandbyTime = 1000;
unsigned long StandbyTimeVoltage = 60000;
unsigned long lastTime = 0;
unsigned long lastTimeCO2 = 0;
unsigned long lastTimeVoltage = 0;

volatile float temperatureOut = 0;
volatile float humidityOut = 0;
float temperature = 0;
float humidity = 0;
float pressure = 0;
float altitude = 0;
int tvoc = 0;
int eco2 = 0;

#define MAX_DELTA 200
volatile unsigned long prevtime, lastReceive;
volatile unsigned int lolen, hilen, state;
static byte receiveCounter = 0;
static long receiveValue = 0;
volatile boolean receiveFlag = 1;

void setup() {
  Wire.begin();
  pinMode(pinRx, INPUT);
  pinMode(pinOnRx, OUTPUT);
  pinMode(pinOnBME, OUTPUT);
  pinMode(pinOnCO2, OUTPUT);

  digitalWrite(pinOnCO2, LOW);
  digitalWrite(pinOnRx, LOW);

  voltage = readVcc();

  u8g.firstPage();
  do {
    drawFirstScreen();
  }
  while ( u8g.nextPage() );

  while (true) {
    if (millis() > 2000 || digitalRead(btnPin1) == HIGH || digitalRead(btnPin2) == HIGH) break;
  }

  delay(200);
  button1.attachClick(click1);
  button1.attachLongPressStart(longPressStart1);
  button2.attachClick(click2);
  button2.attachLongPressStart(longPressStart2);

  EEPROM.get(0, zero_pressure);
  attachInterrupt(0, receive, CHANGE);
  digitalWrite(pinOnBME, HIGH);

  delay(5);
  bme.begin(0x76);
  bme.setSampling(Adafruit_BME280::MODE_FORCED, Adafruit_BME280::SAMPLING_X2, Adafruit_BME280::SAMPLING_X2, Adafruit_BME280::SAMPLING_X2, Adafruit_BME280::FILTER_OFF);
  bme.takeForcedMeasurement();
  temperature = bme.readTemperature();
  humidity = bme.readHumidity();
  pressure = bme.readPressure() / 100.0F;
  altitude = bme.readAltitude(zero_pressure);
}

void loop() {
  button1.tick();
  button2.tick();

  if (screen != 5 && CO2Flag == 0) {
    digitalWrite(pinOnCO2, LOW);
    CO2Flag = 1;
  }

  if (lastReceive < millis()) {
    temperatureOut = 0;
    humidityOut = 0;
    receiveFlag = 0;
  }

  if (lastTimeVoltage < millis()) {
    voltage = readVcc();
    lastTimeVoltage = millis() + StandbyTimeVoltage;
  }

  if (lastTime < millis()) {
    delay(2);
    bme.begin(0x76);
    bme.setSampling(Adafruit_BME280::MODE_FORCED, Adafruit_BME280::SAMPLING_X1, Adafruit_BME280::SAMPLING_X1, Adafruit_BME280::SAMPLING_X1, Adafruit_BME280::FILTER_OFF);
    bme.takeForcedMeasurement();
    if (RxFlag == 0 || screen == 5) {
      if (screen == 1 || screen == 5 || screen == 6 ) temperature = bme.readTemperature();
      if (screen == 2 || screen == 5 || screen == 6 ) humidity = bme.readHumidity();
    }
    if (screen == 3 || screen == 6 ) pressure = bme.readPressure() / 100.0F;
    if (screen == 4) altitude = bme.readAltitude(zero_pressure);
    lastTime = millis() + StandbyTime;
  }

  if (RxFlag == 1 && screen != 5) {
    temperature = temperatureOut;
    humidity = humidityOut;
  }

  if (screen == 1) {
    u8g.firstPage();
    do {
      drawTemperature();
    }
    while ( u8g.nextPage() );
  }

  if (screen == 2) {
    u8g.firstPage();
    do {
      drawHumidity();
    }
    while ( u8g.nextPage() );
  }

  if (screen == 3) {
    u8g.firstPage();
    do {
      drawPressure();
    }
    while ( u8g.nextPage() );
  }

  if (screen == 4) {
    u8g.firstPage();
    do {
      drawAltitude();
    }
    while ( u8g.nextPage() );
  }

  if (screen == 5) {
    if (CO2Flag == 1) {
      digitalWrite(pinOnCO2, HIGH);
      delay(2);
      sgp.begin();
      CO2Flag = 0;
    }
    if (lastTimeCO2 < millis()) {
      sgp.setHumidity(getAbsoluteHumidity(temperature, humidity));
      sgp.IAQmeasure();
      tvoc = sgp.TVOC;
      eco2 = sgp.eCO2;
      lastTimeCO2 = millis() + StandbyTime;
    }
    u8g.firstPage();
    do {
      drawCO2();
    }
    while ( u8g.nextPage() );
  }

  if (screen == 6) {
    u8g.firstPage();
    do {
      drawAll();
    }
    while ( u8g.nextPage() );
  }
}

void click1() {
  screen++;
  if (screen > 5) screen = 1;
  lastTime = 0;
}

void longPressStart1() {
  screen = 6;
  lastTime = 0;
  lastTimeVoltage = 0;
}

void click2() {
  lastTime = 0;
  lastTimeCO2 = 0;
  lastTimeVoltage = 0;
  temperatureOut = 0;
  humidityOut = 0;
}

void longPressStart2() {
  if (screen == 1 || screen == 2 || screen == 6) {
    if (RxFlag == 1) {
      digitalWrite(pinOnRx, LOW);
      RxFlag = 0;
    } else {
      digitalWrite(pinOnRx, HIGH);
      RxFlag = 1;
      receiveFlag = 1;
      lastReceive = millis() + 1500;
    }
  }
  if (screen == 4) {
    zero_pressure = bme.readPressure() / 100.0F;
    EEPROM.put(0, zero_pressure);
  }
  lastTime = 0;
}

const uint8_t signalImgFull[] PROGMEM = {
  0xFC, 0x03, 0x84, 0x03, 0x48, 0x1B, 0x30, 0x1B, 0x30, 0xDB, 0x30, 0xDB, 0x36, 0xDB, 0x36, 0xDB, 0x36, 0xDB, 0x36, 0xDB, 0x36, 0xDB, 0x00, 0x00, 0x00, 0x00, 0x00, 0x00, 0x00, 0x00, 0x00, 0x00
};
const uint8_t signalImgNo[] PROGMEM = {
  0xFC, 0x00, 0x84, 0x00, 0x48, 0x00, 0x30, 0x00, 0x30, 0x00, 0x30, 0x00, 0x30, 0x00, 0x30, 0x00, 0x30, 0x00, 0x30, 0x00, 0x30, 0x00, 0x00, 0x00, 0x00, 0x00, 0x00, 0x00, 0x00, 0x00, 0x00, 0x00
};
const uint8_t batteryImg25[] PROGMEM = {
  0x00, 0x00, 0x00, 0x00, 0x7F, 0xFF, 0x40, 0x01, 0xC0, 0x0D, 0xC0, 0x0D, 0xC0, 0x0D, 0xC0, 0x0D, 0xC0, 0x0D, 0xC0, 0x0D, 0xC0, 0x0D, 0x40, 0x01, 0x7F, 0xFF, 0x00, 0x00, 0x00, 0x00, 0x00, 0x00
};
const uint8_t batteryImg50[] PROGMEM = {
  0x00, 0x00, 0x00, 0x00, 0x7F, 0xFF, 0x40, 0x01, 0xC0, 0x6D, 0xC0, 0x6D, 0xC0, 0x6D, 0xC0, 0x6D, 0xC0, 0x6D, 0xC0, 0x6D, 0xC0, 0x6D, 0x40, 0x01, 0x7F, 0xFF, 0x00, 0x00, 0x00, 0x00, 0x00, 0x00
};
const uint8_t batteryImg75[] PROGMEM = {
  0x00, 0x00, 0x00, 0x00, 0x7F, 0xFF, 0x40, 0x01, 0xC3, 0x6D, 0xC3, 0x6D, 0xC3, 0x6D, 0xC3, 0x6D, 0xC3, 0x6D, 0xC3, 0x6D, 0xC3, 0x6D, 0x40, 0x01, 0x7F, 0xFF, 0x00, 0x00, 0x00, 0x00, 0x00, 0x00
};
const uint8_t batteryImg100[] PROGMEM = {
  0x00, 0x00, 0x00, 0x00, 0x7F, 0xFF, 0x40, 0x01, 0xDB, 0x6D, 0xDB, 0x6D, 0xDB, 0x6D, 0xDB, 0x6D, 0xDB, 0x6D, 0xDB, 0x6D, 0xDB, 0x6D, 0x40, 0x01, 0x7F, 0xFF, 0x00, 0x00, 0x00, 0x00, 0x00, 0x00
};
const uint8_t temperatureImg[] PROGMEM = {
  0x00, 0x00, 0x1F, 0x80, 0x00, 0x00, 0x00, 0x00, 0x7F, 0xC0, 0x00, 0x00, 0x00, 0x00, 0xF9, 0xE0, 0x00, 0x00, 0x00, 0x01, 0xE0, 0x70, 0x00, 0x00, 0x00, 0x01, 0xC0, 0x70, 0x00, 0x00, 0x00, 0x03,
  0x80, 0x39, 0xFC, 0x00, 0x00, 0x03, 0x80, 0x39, 0xFC, 0x00, 0x00, 0x03, 0x80, 0x38, 0x00, 0x00, 0x00, 0x03, 0x80, 0x38, 0x00, 0x00, 0x00, 0x03, 0x80, 0x38, 0x00, 0x00, 0x00, 0x03, 0x80, 0x39,
  0xFC, 0x00, 0x00, 0x03, 0x80, 0x39, 0xFC, 0x00, 0x00, 0x03, 0x8E, 0x38, 0x00, 0x00, 0x00, 0x03, 0x9F, 0x38, 0x00, 0x00, 0x00, 0x03, 0x9F, 0x39, 0xFC, 0x00, 0x00, 0x03, 0x9F, 0x39, 0xFC, 0x00,
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  0x00, 0x00, 0x00, 0x0F, 0x00, 0x0E, 0x00, 0x00, 0x00, 0x07, 0x80, 0x3C, 0x00, 0x00, 0x00, 0x03, 0xF1, 0xF8, 0x00, 0x00, 0x00, 0x00, 0xFF, 0xE0, 0x00, 0x00, 0x00, 0x00, 0x3F, 0x80, 0x00, 0x00
};
const uint8_t humidityImg[] PROGMEM = {
  0x00, 0x00, 0x00, 0x00, 0x00, 0x00, 0x00, 0x18, 0x00, 0x00, 0x00, 0x00, 0x3C, 0x00, 0x00, 0x00, 0x00, 0x3C, 0x00, 0x00, 0x00, 0x00, 0x7E, 0x00, 0x00, 0x00, 0x00, 0xFF, 0x00, 0x00, 0x00, 0x00,
  0xFF, 0x00, 0x00, 0x00, 0x01, 0xFF, 0x80, 0x00, 0x00, 0x03, 0xFF, 0xC0, 0x00, 0x00, 0x03, 0xE7, 0xC0, 0x00, 0x00, 0x07, 0xC3, 0xE0, 0x00, 0x00, 0x07, 0xC3, 0xE0, 0x00, 0x00, 0x0F, 0x81, 0xF0,
  0x00, 0x00, 0x1F, 0x00, 0xF8, 0x00, 0x00, 0x1F, 0x00, 0xF8, 0x00, 0x00, 0x3E, 0x00, 0x7C, 0x00, 0x00, 0x3C, 0x00, 0x3C, 0x00, 0x00, 0x7C, 0x00, 0x3E, 0x00, 0x00, 0xF8, 0x00, 0x1F, 0x00, 0x00,
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  0x00, 0x00, 0x1F, 0xFF, 0xF8, 0x00, 0x00, 0x07, 0xFF, 0xE0, 0x00, 0x00, 0x00, 0xFF, 0x00, 0x00
};
const uint8_t pressureImg[] PROGMEM = {
  0x00, 0x00, 0x00, 0x00, 0x00, 0x00, 0x00, 0x00, 0x00, 0x00, 0x00, 0x00, 0x00, 0x00, 0x00, 0x00, 0x00, 0x00, 0x00, 0x00, 0x00, 0x00, 0x00, 0x00, 0x00, 0x00, 0x00, 0x00, 0x00, 0x00, 0x00, 0x00,
  0x0F, 0xF0, 0x00, 0x00, 0x00, 0x00, 0xFF, 0xFF, 0x00, 0x00, 0x00, 0x03, 0xFF, 0xFF, 0xC0, 0x00, 0x00, 0x0F, 0xFF, 0xFF, 0xF0, 0x00, 0x00, 0x3F, 0xC0, 0x03, 0xFC, 0x00, 0x00, 0x7E, 0x03, 0xC0,
  0x7E, 0x00, 0x00, 0xF8, 0x03, 0xC0, 0x1F, 0x00, 0x01, 0xF0, 0x03, 0xC0, 0x0F, 0x80, 0x03, 0xE6, 0x03, 0xC0, 0x67, 0xC0, 0x07, 0xCE, 0x03, 0xC0, 0x73, 0xE0, 0x0F, 0x8F, 0x03, 0xC0, 0xF1, 0xF0,
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  0x00, 0x00, 0x00, 0x00, 0x00, 0x00, 0x00, 0x00, 0x00, 0x00, 0x00, 0x00, 0x00, 0x00, 0x00, 0x00, 0x00, 0x00, 0x00, 0x00, 0x00, 0x00, 0x00, 0x00, 0x00, 0x00, 0x00, 0x00, 0x00, 0x00, 0x00, 0x00
};
const uint8_t altitudeImg[] PROGMEM = {
  0x00, 0x00, 0x00, 0x00, 0x00, 0x00, 0x00, 0x00, 0x00, 0x00, 0x00, 0x00, 0x00, 0x00, 0x00, 0x00, 0x00, 0x00, 0x00, 0x00, 0x00, 0x00, 0x00, 0x00, 0x00, 0x00, 0x7F, 0xFE, 0x00, 0x00, 0x00, 0x01,
  0xFF, 0xFF, 0x80, 0x00, 0x00, 0x07, 0xFF, 0xFF, 0xE0, 0x00, 0x00, 0x0F, 0xC0, 0x03, 0xF0, 0x00, 0x00, 0x3E, 0x00, 0x00, 0x7C, 0x00, 0x00, 0x7C, 0x00, 0x00, 0x3E, 0x00, 0x00, 0xF0, 0x1F, 0xF8,
  0x0F, 0x00, 0x01, 0xE0, 0xFF, 0xFF, 0x07, 0x80, 0x01, 0xC1, 0xFF, 0xFF, 0x83, 0x80, 0x03, 0x83, 0xE0, 0x07, 0xC1, 0xC0, 0x07, 0x87, 0x80, 0x01, 0xE1, 0xE0, 0x07, 0x0F, 0x00, 0x00, 0xF0, 0xE0,
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  0xF0, 0x00, 0x00, 0x07, 0xFF, 0xFF, 0xE0, 0x00, 0x00, 0x01, 0xFF, 0xFF, 0x80, 0x00, 0x00, 0x00, 0x7F, 0xFE, 0x00, 0x00, 0x00, 0x00, 0x00, 0x00, 0x00, 0x00, 0x00, 0x00, 0x00, 0x00, 0x00, 0x00
};
const uint8_t co2Img[] PROGMEM = {
  0x00, 0x00, 0x00, 0x00, 0x00, 0x00, 0x00, 0x00, 0x00, 0x00, 0x00, 0x00, 0x00, 0x00, 0x00, 0x00, 0x00, 0x00, 0x00, 0x00, 0x00, 0x00, 0x00, 0x00, 0x00, 0x00, 0x00, 0x00, 0x00, 0x00, 0x00, 0x00,
  0x00, 0x00, 0x00, 0x00, 0x00, 0x00, 0x00, 0x00, 0x00, 0x00, 0x00, 0x00, 0x00, 0x00, 0x00, 0x00, 0x00, 0x00, 0x00, 0x00, 0x00, 0x00, 0x00, 0x03, 0xF8, 0x03, 0xC0, 0x00, 0x00, 0x0F, 0xFE, 0x1F,
  0xF8, 0x00, 0x00, 0x1F, 0xFF, 0xBF, 0xFE, 0x00, 0x00, 0x7C, 0x07, 0xFC, 0x3F, 0x00, 0x00, 0x78, 0x03, 0xF0, 0x0F, 0x80, 0x00, 0xF0, 0x01, 0xE0, 0x07, 0x80, 0x03, 0xE0, 0x00, 0xC0, 0x03, 0xC0,
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  0xFC, 0x00, 0x00, 0x00, 0x00, 0x00, 0x00, 0x00, 0x00, 0x00, 0x00, 0x00, 0x00, 0x00, 0x00, 0x00, 0x00, 0x00, 0x00, 0x00, 0x00, 0x00, 0x00, 0x00, 0x00, 0x00, 0x00, 0x00, 0x00, 0x00, 0x00, 0x00
};

void drawFirstScreen(void) {
  u8g.setFont(u8g_font_9x15);
  u8g.setPrintPos(10, 12);
  u8g.print("Battery:");
  if (voltage != 100) u8g.print(" ");
  u8g.print(voltage);
  u8g.print("%");
  u8g.setFont(u8g_font_helvB18);
  u8g.setPrintPos(14, 36);
  u8g.print("Weather");
  u8g.setPrintPos(21, 60);
  u8g.print("Station");
}

void drawAll(void) {
  u8g.setFont(u8g_font_9x15);
  if (RxFlag == 1) {
    if (receiveFlag == 1) {
      u8g.drawBitmapP(0, 2, 2, 16, signalImgFull);
    } else {
      u8g.setPrintPos(8, 13);
      u8g.print("NoSign.");
      u8g.drawBitmapP(0, 2, 2, 16, signalImgNo);
    }
  } else {
    u8g.setPrintPos(8, 13);
    u8g.print("Inside");
    u8g.drawBitmapP(0, 2, 2, 16, signalImgNo);
  }
  u8g.setPrintPos(68, 13);
  if (voltage != 100) u8g.print(" ");
  u8g.print(voltage);
  u8g.print("%");
  if (voltage >= 85) u8g.drawBitmapP(108, 0, 2, 16, batteryImg100);
  if (voltage < 85 && voltage >= 63) u8g.drawBitmapP(108, 0, 2, 16, batteryImg75);
  if (voltage < 63 && voltage >= 38) u8g.drawBitmapP(108, 0, 2, 16, batteryImg50);
  if (voltage < 38) u8g.drawBitmapP(108, 0, 2, 16, batteryImg25);
  u8g.setPrintPos(0, 28);
  u8g.print("Temp: ");
  if (temperature > -9.9) u8g.print(" ");
  u8g.print(temperature, 1);
  u8g.print("C");
  if (RxFlag == 1) u8g.print("->"); else u8g.print("<-");
  u8g.setPrintPos(0, 44);
  u8g.print("Humid: ");
  u8g.print(humidity, 1);
  u8g.print("%");
  if (RxFlag == 1) u8g.print("->"); else u8g.print("<-");
  u8g.setPrintPos(0, 60);
  u8g.print("Press: ");
  u8g.print(pressure * 0.750062, 0);
  u8g.print("mmHg");
}

void drawTemperature(void) {
  u8g.setFont(u8g_font_9x15);
  if (RxFlag == 1) {
    u8g.setPrintPos(9, 12);
    u8g.print("Temperat.Out");
  } else {
    u8g.setPrintPos(13, 12);
    u8g.print("Temperature");
  }
  u8g.setFont(u8g_font_helvB18);
  u8g.setPrintPos(50, 47);
  if (temperature > 99.9 || temperature < -9.9) u8g.print(temperature, 0);
  else u8g.print(temperature, 1);
  u8g.print(" C");
  u8g.drawBitmapP( -2, 16, 6, 48, temperatureImg);
}

void drawHumidity(void) {
  u8g.setFont(u8g_font_9x15);
  if (RxFlag == 1) {
    u8g.setPrintPos(24, 12);
    u8g.print("Humid.Out");
  } else {
    u8g.setPrintPos(27, 12);
    u8g.print("Humidity");
  }
  u8g.setFont(u8g_font_helvB18);
  u8g.setPrintPos(50, 47);
  if (humidity > 99.9) u8g.print(humidity, 0);
  else u8g.print(humidity, 1);
  u8g.print(" %");
  u8g.drawBitmapP( 0, 16, 5, 48, humidityImg);
}

void drawPressure(void) {
  u8g.setFont(u8g_font_9x15);
  u8g.setPrintPos(26, 12);
  u8g.print("Pressure");
  u8g.setPrintPos(56, 35);
  u8g.print(pressure, 0);
  u8g.print("hPa");
  u8g.setPrintPos(56, 50);
  u8g.print(pressure * 0.750062, 0);
  u8g.print("mmHg");
  u8g.drawBitmapP( 0, 15, 6, 48, pressureImg);
}

void drawAltitude(void) {
  u8g.setFont(u8g_font_9x15);
  u8g.setPrintPos(27, 12);
  u8g.print("Altitude");
  u8g.setFont(u8g_font_helvB18);
  if (altitude < 10 && altitude >= -9.99) {
    u8g.setPrintPos(54, 47);
    u8g.print(altitude, 2);
  }
  if ((altitude >= 10 && altitude < 99.9) || (altitude < -10 && altitude > -99.9)) {
    u8g.setPrintPos(54, 47);
    u8g.print(altitude, 1);
  }
  if (altitude >= 100 && altitude < 999.9) {
    u8g.setPrintPos(57, 47);
    u8g.print(altitude, 0);
  }
  if (altitude >= 1000 || altitude <= -100) {
    u8g.setPrintPos(52, 47);
    u8g.print(altitude, 0);
  }
  u8g.print("m");
  u8g.drawBitmapP( -1, 14, 6, 48, altitudeImg);
}

void drawCO2(void) {
  u8g.setFont(u8g_font_9x15);
  u8g.setPrintPos(0, 12);
  u8g.print("Carbon Dioxide");
  u8g.setPrintPos(57, 35);
  u8g.print(tvoc);
  u8g.print("ppb");
  u8g.setPrintPos(57, 50);
  u8g.print(eco2);
  u8g.print("ppm");
  u8g.drawBitmapP( 2, 12, 6, 48, co2Img);
}

boolean CheckValue(unsigned int base, unsigned int value) {
  return ((value == base) || ((value > base) && ((value - base) < MAX_DELTA)) || ((value < base) && ((base - value) < MAX_DELTA)));
}
void receive() {
  state = digitalRead(pinRx);
  if (state == HIGH) lolen = micros() - prevtime;
  else hilen = micros() - prevtime;
  prevtime = micros();
  if (state == LOW) {
    if (CheckValue(400, hilen) && CheckValue(800, lolen)) {
      receiveValue = (receiveValue << 1) | 1;
      receiveCounter++;
    }
    else if (CheckValue(800, hilen) && CheckValue(400, lolen)) {
      receiveValue = (receiveValue << 1) | 0;
      receiveCounter++;
    }
    else receiveCounter = 0;
  } else if (lolen > 1800 && (receiveCounter == 12 || receiveCounter == 13)) {
    if (receiveValue >= 1000 && receiveValue < 2000) temperatureOut = -(100.0 - ((receiveValue - 1000.0) * 0.1));
    if (receiveValue >= 2000 && receiveValue < 3000) temperatureOut = (receiveValue - 2000.0) * 0.1;
    if (receiveValue >= 3000 && receiveValue < 4000) humidityOut = (receiveValue - 3000.0) * 0.1;
    lastReceive = millis() + 1500;
    receiveFlag = 1;
    receiveCounter = 0;
    receiveValue = 0;
  }
}

uint32_t getAbsoluteHumidity(float temperature, float humidity) {
  const float absoluteHumidity = 216.7f * ((humidity / 100.0f) * 6.112f * exp((17.62f * temperature) / (243.12f + temperature)) / (273.15f + temperature));
  const uint32_t absoluteHumidityScaled = static_cast<uint32_t>(1000.0f * absoluteHumidity);
  return absoluteHumidityScaled;
}

long readVcc() {
  ADMUX = _BV(REFS0) | _BV(MUX3) | _BV(MUX2) | _BV(MUX1);
  delay(2);
  ADCSRA |= _BV(ADSC);
  while (bit_is_set(ADCSRA, ADSC));
  uint8_t low  = ADCL;
  uint8_t high = ADCH;
  long result = (high << 8) | low;
  result = (1.098 * 1023 * 1000 / result) - 3150;
  if (result > 999 || result < 1) {
    if (result > 999) return 100;
    else return 0;
  } else {
    return result * 0.1;
  }
}
